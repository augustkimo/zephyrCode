## nrf52820test/Kconfig.board
```kconfig
# nRF52820test board configuration

config BOARD_NRF52820test
	bool "nRF52820test"
	depends on SOC_NRF52820_QDAA
```

## nrf52820test/Kconfig.defconfig
```kconfig
# nRF52820test board configuration


if BOARD_NRF52820test

config BOARD
	default "nrf52820test"

endif # BOARD_NRF52820test
```

## nrf52820test/nrf52820test_defconfig
```kconfig
CONFIG_SOC_SERIES_NRF52X=y
CONFIG_SOC_NRF52820_QDAA=y
CONFIG_BOARD_NRF52820test=y

# enable GPIO
CONFIG_GPIO=y
```
